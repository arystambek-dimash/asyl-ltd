## firmware/esp32-conveyor/main/Kconfig.projbuild
```kconfig
menu "ASYL conveyor controller"

config ASYL_ALLOW_CUSTOM_API_BASE_URL
    bool "DEVELOPMENT ONLY: allow BLE to override API base URL"
    default n
    help
        Keep disabled in production. When disabled, provisioning accepts only
        the built-in https://asyl-ltd.kz/api URL, preventing credential
        redirection to another host after provisioning credentials leak.

config ASYL_API_SYNC_PATH
    string "Device sync path"
    default "/conveyors/v1/device/sync/"

config ASYL_FIRMWARE_VERSION
    string "Firmware version reported to API"
    default "1.0.0"

config ASYL_RELAY_GPIO
    int "Relay command GPIO"
    range 0 48
    default 26

config ASYL_RELAY_ACTIVE_HIGH
    bool "Relay is active-high"
    default y

config ASYL_FEEDBACK_GPIO
    int "Independent contactor feedback GPIO"
    range 0 48
    default 27

config ASYL_FEEDBACK_ACTIVE_HIGH
    bool "Feedback is active-high"
    default y

config ASYL_FEEDBACK_SETTLE_MS
    int "Maximum feedback transition time (ms)"
    range 50 1000
    default 400

config ASYL_LOCAL_FAIL_OFF_MS
    int "Absolute local fail-OFF deadline (ms)"
    range 500 2000
    default 2000

config ASYL_MAX_COMMAND_LEASE_MS
    int "Maximum accepted ON lease (ms)"
    range 250 1500
    default 1500

config ASYL_DEFAULT_POLL_MS
    int "Default API polling interval (ms)"
    range 100 500
    default 500

config ASYL_HTTP_TIMEOUT_MS
    int "HTTPS request timeout (ms)"
    range 200 1500
    default 900

config ASYL_SERVER_CLOCK_SKEW_SECONDS
    int "Maximum accepted server clock skew (seconds)"
    range 1 30
    default 10

config ASYL_WIFI_MAX_BACKOFF_MS
    int "Maximum Wi-Fi reconnect backoff (ms)"
    range 1000 60000
    default 30000

config ASYL_PROV_SERVICE_PREFIX
    string "BLE provisioning service prefix"
    default "ASYL-CONV"

config ASYL_PROV_SEC2_SALT_HEX
    string "Security2 SRP6a salt (hex, unique per device)"
    default ""
    help
        Generate unique Security2 credentials for every physical controller.
        Provisioning refuses to start when this value is empty or malformed.

config ASYL_PROV_SEC2_VERIFIER_HEX
    string "Security2 SRP6a verifier (hex, unique per device)"
    default ""
    help
        Generate with the ESP-IDF esp_prov tool. Never reuse example verifier
        material in production.

config ASYL_PROVISION_BUTTON_GPIO
    int "Hold-at-boot provisioning reset GPIO"
    range 0 48
    default 4

config ASYL_PROVISION_BUTTON_ACTIVE_LOW
    bool "Provisioning reset button is active-low"
    default y

config ASYL_PROVISION_HOLD_MS
    int "Provisioning reset hold time (ms)"
    range 1000 10000
    default 3000

endmenu
```
